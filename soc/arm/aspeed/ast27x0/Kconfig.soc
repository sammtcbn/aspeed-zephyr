## soc/arm/aspeed/ast27x0/Kconfig.soc
```kconfig
# SPDX-License-Identifier: Apache-2.0
#
# Copyright (c) 2023 ASPEED Technology Inc.

choice
	prompt "ASPEED AST27X0 Selection"
	depends on SOC_SERIES_AST27X0

config SOC_AST2700
	bool "AST2700"

endchoice
```
